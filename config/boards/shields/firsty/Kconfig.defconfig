## config/boards/shields/firsty/Kconfig.defconfig
```kconfig
if SHIELD_firsty_LEFT

config ZMK_KEYBOARD_NAME
    default "Firsty"

config ZMK_SPLIT_ROLE_CENTRAL
    default y

endif

if SHIELD_FIRSTY_LEFT || SHIELD_FIRSTY_RIGHT

config ZMK_SPLIT
    default y

endif
```

## config/boards/shields/firsty/Kconfig.shield
```kconfig
# Copyright (c) 2020 Pete Johanson
# SPDX-License-Identifier: MIT

config SHIELD_FIRSTY_LEFT
    def_bool $(shields_list_contains,firsty_left)

config SHIELD_FIRSTY_RIGHT
    def_bool $(shields_list_contains,firsty_right)
```
